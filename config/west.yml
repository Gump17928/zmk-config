## config/west.yml
```yaml
manifest:
  defaults:
    revision: v0.3
  remotes:
    - name: zmkfirmware
      url-base: https://github.com/zmkfirmware
    # support nice_oled and nice_epaper
    # - name: mctechnology17
    #   url-base: https://github.com/mctechnology17

    - name: Gump17928
      url-base: https://github.com/Gump17928
    # Additional modules containing boards/shields/custom code can be listed here as well
    # See https://docs.zephyrproject.org/3.2.0/develop/west/manifest.html#projects
  projects:
    - name: zmk
      remote: zmkfirmware
      revision: main
      import: app/west.yml
    # support nice_oled and nice_epaper
    # - name: zmk-nice-oled
    #   remote: mctechnology17
    #   revision: main
    - name: sofle_custom_oled        # <-- your module
      remote: Gump17928
      revision: main
  self:
    path: config
```
